## config/west.yml
```yaml
manifest:
  remotes:
    - name: zmkfirmware 
      url-base: https://github.com/zmkfirmware
    - name: MeowCatpawkittie
      url-base: https://github.com/MeowCatpawkittie
    - name: caksoylar
      url-base: https://github.com/caksoylar  
    - name: sekigon-gonnoc
      url-base: https://github.com/sekigon-gonnoc
    - name: zettaface  # <-- Input Processor Keybind
      url-base: https://github.com/zettaface
    - name: kot149
      url-base: https://github.com/kot149
    - name: ssbb
      url-base: https://github.com/ssbb

    - name: iwk7273
      url-base: https://github.com/iwk7273

      
  projects:
    - name: zmk
      remote: zmkfirmware
      revision: main
      import: app/west.yml
    - name: zmk-driver-paw3222
      remote: sekigon-gonnoc
      revision: main
    - name: zmk-rgbled-widget
      remote: caksoylar
      revision: main
    - name: zmk-input-processor-keybind
      remote: zettaface
      revision: main
    - name: zmk-mouse-gesture
      remote: kot149
      revision: v1
    - name: zmk-listeners
      remote: ssbb
      revision: v1

    - name: zmk-feature-sensor_rotation
      remote: iwk7273
      revision: main
    - name: zmk-feature-xy_clipper
      remote: iwk7273
      revision: main

  self:
    path: config
```
